#include "lcd.h"

#define XLevelL		0x00
#define XLevelH		0x10
#define XLevel		((XLevelH&0x0F)*16+XLevelL)
#define Max_Column	128
#define Max_Row		  64
#define	Brightness	0xCF 

#define X_WIDTH 128
#define Y_WIDTH 64

const u8 F6x8[][6] =
{
    { 0x00, 0x00, 0x00, 0x00, 0x00, 0x00 },   // sp
    { 0x00, 0x00, 0x00, 0x2f, 0x00, 0x00 },   // !
    { 0x00, 0x00, 0x07, 0x00, 0x07, 0x00 },   // "
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    { 0x80, 0x80, 0x80, 0x80, 0x80, 0x80 }    // horiz lines
};

void LCD_WrDat(u8 data)
{
	u8 i=8;
	//LCD_CS=0;;
	SET_LCD_DC;
	delay_us(1);
  CLR_LCD_SCL;
	delay_us(5);   
  while(i--)
  {
    if(data&0x80)
		{
			SET_LCD_SDA;
			delay_us(1);
		}
    else
		{
			CLR_LCD_SDA;
			delay_us(1);
		}
    SET_LCD_SCL; 
    delay_us(3);            
    CLR_LCD_SCL;
		delay_us(1); 
    data<<=1;    
		delay_us(1);
  }
	//LCD_CS=1;
}

void LCD_WrCmd(u8 cmd)
{
	u8 i=8;
	//LCD_CS=0;;
	CLR_LCD_DC;
	delay_us(1);
  CLR_LCD_SCL;
	delay_us(5);
  while(i--)
  {
    if(cmd&0x80)
		{
			SET_LCD_SDA;
		  delay_us(1);
		}
    else
		{
			CLR_LCD_SDA;
			delay_us(1);
		}
    SET_LCD_SCL;
		delay_us(3);          
    CLR_LCD_SCL;
	  delay_us(1); 
    cmd<<=1;
		delay_us(1);
  } 	
	//LCD_CS=1;
}

void LCD_Set_Pos(u8 x, u8 y)
{ 
  LCD_WrCmd(0xb0+y);
  LCD_WrCmd(((x&0xf0)>>4)|0x10);
  LCD_WrCmd((x&0x0f)|0x01); 
} 

void LCD_Fill(u8 bmp_data)
{
	u8 y,x;
	
	for(y=0;y<8;y++)
	{
		LCD_WrCmd(0xb0+y);
		LCD_WrCmd(0x01);
		LCD_WrCmd(0x10);
		for(x=0;x<X_WIDTH;x++)
			LCD_WrDat(bmp_data);
	}
}

void LCD_CLS(void)
{
	u8 y,x;	
	for(y=0;y<8;y++)
	{
		LCD_WrCmd(0xb0+y);
		LCD_WrCmd(0x01);
		LCD_WrCmd(0x10); 
		for(x=0;x<X_WIDTH;x++)
			LCD_WrDat(0);
	}
}

void Set_Display_On_Off(unsigned char d)
{
	LCD_WrCmd(0xAE|d);			// Set Display On/Off						
}

void adjust(u8 a)
{
  LCD_WrCmd(a);	//????0x0000~0x003f  
}

void Set_Display_Clock(unsigned char d)
{
	LCD_WrCmd(0xD5);			// Set Display Clock Divide Ratio / Oscillator Frequency
	LCD_WrCmd(d);			//   Default => 0x80
}

void Set_Multiplex_Ratio(unsigned char d)
{
	LCD_WrCmd(0xA8);			// Set Multiplex Ratio
	LCD_WrCmd(d);			//   Default => 0x3F (1/64 Duty)
}

void Set_Display_Offset(unsigned char d)
{
	LCD_WrCmd(0xD3);			// Set Display Offset
	LCD_WrCmd(d);			//   Default => 0x00
}

void Set_Charge_Pump(unsigned char d)
{
	LCD_WrCmd(0x8D);			// Set Charge Pump
	LCD_WrCmd(0x10|d);			//   Default => 0x10
}

void SetStartLine(unsigned char d)
{
	LCD_WrCmd(0x40|d);			// Set Display Start Line
}

void SetAddressingMode(unsigned char d)
{
	LCD_WrCmd(0x20);			// Set Memory Addressing Mode
	LCD_WrCmd(d);			//   Default => 0x02
}

void Set_Segment_Remap(unsigned char d)
{
	LCD_WrCmd(0xA0|d);			// Set Segment Re-Map
}

void Set_Common_Remap(unsigned char d)
{
	LCD_WrCmd(0xC0|d);			// Set COM Output Scan Direction
}

void Set_Common_Config(unsigned char d)
{
	LCD_WrCmd(0xDA);			// Set COM Pins Hardware Configuration
	LCD_WrCmd(0x02|d);			//   Default => 0x12 (0x10)
}

void SetContrastControl(unsigned char d)
{
	LCD_WrCmd(0x81);			// Set Contrast Control
	LCD_WrCmd(d);			//   Default => 0x7F
}

void Set_Precharge_Period(unsigned char d)
{
	LCD_WrCmd(0xD9);			// Set Pre-Charge Period
	LCD_WrCmd(d);			//   Default => 0x22 (2 Display Clocks [Phase 2] / 2 Display Clocks [Phase 1])
}

void Set_VCOMH(unsigned char d)
{
	LCD_WrCmd(0xDB);			// Set VCOMH Deselect Level
	LCD_WrCmd(d);			//   Default => 0x20 (0.77*VCC)
}

void Set_Entire_Display(unsigned char d)
{
	LCD_WrCmd(0xA4|d);			// Set Entire Display On / Off
}

void Set_Inverse_Display(unsigned char d)
{
	LCD_WrCmd(0xA6|d);			// Set Inverse Display On/Off
}

void LCD_Init(void)        
{
  SET_LCD_SCL;
  CLR_LCD_RST;
  delay_ms(50);
  SET_LCD_RST;

  Set_Display_On_Off(0x00);
	delay_ms(10);	  // Display Off (0x00/0x01)
  Set_Display_Clock(0x80);	
	delay_ms(10);		  // Set Clock as 100 Frames/Sec
  Set_Multiplex_Ratio(0x3F);
	delay_ms(10);		// 1/64 Duty (0x0F~0x3F)
  Set_Display_Offset(0x00);
	delay_ms(10);	  // Shift Mapping RAM Counter (0x00~0x3F)
  SetStartLine(0x00);
	delay_ms(10);	      // Set Mapping RAM Display Start Line (0x00~0x3F)
  Set_Charge_Pump(0x04);
	delay_ms(10);		    // Enable Embedded DC/DC Converter (0x00/0x04)
  SetAddressingMode(0x02);
	delay_ms(10);		  // Set Page Addressing Mode (0x00/0x01/0x02)
  Set_Segment_Remap(0x01);
	delay_ms(10);			  // Set SEG/Column Mapping     0x00???? 0x01??
  Set_Common_Remap(0x08);
	delay_ms(10);				  // Set COM/Row Scan Direction 0x00???? 0x08??
  Set_Common_Config(0x10);
	delay_ms(10);		  // Set Sequential Configuration (0x00/0x10)
  SetContrastControl(Brightness);
	delay_ms(10);	// Set SEG Output Current
  Set_Precharge_Period(0xF1);
	delay_ms(10);	// Set Pre-Charge as 15 Clocks & Discharge as 1 Clock
  Set_VCOMH(0x40);		
	delay_ms(10);	        // Set VCOM Deselect Level
  Set_Entire_Display(0x00);
	delay_ms(10);	  // Disable Entire Display On (0x00/0x01)
  Set_Inverse_Display(0x00);
	delay_ms(10);	// Disable Inverse Display On (0x00/0x01)  
  Set_Display_On_Off(0x01);	
	delay_ms(10);	  // Display On (0x00/0x01)
  LCD_Fill(0x00); 
	delay_ms(10);	 
	LCD_Set_Pos(0,0); 
	delay_ms(10);	
} 

void LCD_P6x8Str(u8 x,u8 y,u8 ch[])
{
  u8 i=0,j=0;      
	LCD_Set_Pos(x,y);
	j=ch[0]-32;
	for(i=0;i<6;i++)     
  	  LCD_WrDat(F6x8[j][i]); 
}
void LCD_Show_M(u8 y,unsigned long int num)
{
	u8 num1, i, j, k, c;
	num1=num/65536;
	k=100;
	for(i=0;i<3;i++)
	{
		LCD_Set_Pos(0+6*i,y);
		c=(num1/k)%10+16;
		for(j=0;j<6;j++)     
  	  LCD_WrDat(F6x8[c][j]); 
		k/=10;	
	}
	num1=(num%65536)/256;
	k=100;
	for(i=0;i<3;i++)
	{
		LCD_Set_Pos(40+6*i,y);
		c=(num1/k)%10+16;
		for(j=0;j<6;j++)     
  	  LCD_WrDat(F6x8[c][j]); 
		k/=10;	
	}
	num1=num%256;
	k=100;
	for(i=0;i<3;i++)
	{
		LCD_Set_Pos(80+6*i,y);
		c=(num1/k)%10+16;
		for(j=0;j<6;j++)     
  	  LCD_WrDat(F6x8[c][j]); 
		k/=10;	
	}	
}
void LCD_ShowNum(u8 x,u8 y, unsigned int num)
{
	u8 i,j,c=0;
	unsigned int t=1,k=1;
	if(num==0)
	{
		LCD_Set_Pos(x,y);
		for(j=0;j<6;j++)     
  	  LCD_WrDat(F6x8[16][j]); 
	}
  else	
	{
	t=num;
	for(i=0;t>0;i++)
	{
		t=t/10;
		k=k*10;	
	}
	if(x+6*i>126)
		x=126-6*i;
	k=k/10;
	while(i>0)
	{
		LCD_Set_Pos(x,y);
		c=(num/k)%10;
		c=c+16;
		for(j=0;j<6;j++)     
  	  LCD_WrDat(F6x8[c][j]); 
		k=k/10;
		x=x+6;
		i--;
	}
}
}

